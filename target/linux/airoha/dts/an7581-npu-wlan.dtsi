// SPDX-License-Identifier: (GPL-2.0-only OR BSD-2-Clause)

/*
 * Memory regions used by the NPU Wi-Fi packet offloading only. Boards that
 * do not run an Airoha-offloaded Wi-Fi chip must not reserve them: the NPU
 * needs the binary region alone to run its firmware and to offload flows.
 */

&{/reserved-memory} {
	#address-cells = <2>;
	#size-cells = <2>;
	ranges;

&npu {
	memory-region = <&npu_binary>;
	memory-region-names = "binary";
};
